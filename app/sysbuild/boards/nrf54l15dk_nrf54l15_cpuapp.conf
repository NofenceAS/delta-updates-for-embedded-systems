## app/sysbuild/boards/nrf54l15dk_nrf54l15_cpuapp.conf
```kconfig
# The nrfx SPI driver depends on semaphores, which require multithreading
CONFIG_SPI=n
CONFIG_SPI_NOR=n

# Note: This needs to be set to 256 for MCUBOOT to load the application image,
# likely, this is due to the partition map being wrong
CONFIG_BOOT_MAX_IMG_SECTORS=256
# FPROTECT needs to be disabled for nRF54L15
CONFIG_FPROTECT=n
```

## app/sysbuild/mcuboot/boards/nrf54l15dk_nrf54l15_cpuapp.conf
```kconfig
# The nrfx SPI driver depends on semaphores, which require multithreading
CONFIG_SPI=n
CONFIG_SPI_NOR=n

# Note: This needs to be set to 512 as we can have large images, for MCUBOOT to load the application image,
# likely, this is due to the partition map being wrong
CONFIG_BOOT_MAX_IMG_SECTORS=1024
CONFIG_BOOT_MAX_IMG_SECTORS_AUTO=n
# FPROTECT needs to be disabled for nRF54L15
CONFIG_FPROTECT=n
```
